ASAP2_VERSION 1 61
/begin PROJECT template_A2L ""
/* TODO: Change name according to project needs */
/begin MODULE template_A2L ""
/* TODO: Change name according to project needs */
/* A2ML - Language definitions */
/begin IF_DATA XCPplus 0x0102 /* TODO: Change version to the needed one */ /* Include of the generated TL/PL-information */
 /include "Xcp_A2L.a2l" /* TODO: Add the correct include */ /end IF_DATA
/* TODO: Add your measurements here... */
/end MODULE
/end PROJECT
