AUTOSAR XML (schema 4-2-2)
# Copyright (C) Infineon Technologies (2020)
# All rights reserved.
package /AURIX2G_Irq/BswModuleDescriptions
  bsw module description Irq: category=BSW_MODULE, module-id=255  # IRQ Driver
    provided-entrys:
      Irq_ClearAllInterruptFlags
      IrqCan_Init
      IrqDmu_Init
      IrqGpsr_Init
      IrqGtm_Init
      IrqSent_Init
      IrqSpi_Init
      IrqStm_Init
    bsw internal behavior IrqBehavior
      8 x bsw called entity, all with reentrancy-level=NON-REENTRANT:
        IrqCan_Init: implemented-entry=IrqCan_Init
        IrqGtm_Init: implemented-entry=IrqGtm_Init
        IrqGpsr_Init: implemented-entry=IrqGpsr_Init
        IrqSpi_Init: implemented-entry=IrqSpi_Init
        IrqDmu_Init: implemented-entry=IrqDmu_Init
        IrqSent_Init: implemented-entry=IrqSent_Init
        IrqStm_Init: implemented-entry=IrqStm_Init
        Irq_ClearAllInterruptFlags: implemented-entry=Irq_ClearAllInterruptFlags
package /AURIX2G_Irq/BswModuleEntrys
  8 x bsw module entry, all with is-reentrant=false, is-synchronous=true, call-type=REGULAR, execution-context=TASK, sw-service-impl-policy=STANDARD:
    Irq_ClearAllInterruptFlags
    IrqCan_Init
    IrqDmu_Init
    IrqGpsr_Init
    IrqGtm_Init
    IrqSent_Init
    IrqSpi_Init
    IrqStm_Init
package /AURIX2G_Irq/Implementations
  bsw implementation Irq: programming-language=C, sw-version=20.0.0, vendor-id=17, ar-release-version=4.2.2, behavior=IrqBehavior, vendor-specific-module-def=Irq
    code-descriptors:
      code Files: artifact-descriptors=[{short-label=ssc::src::Irq.c, category=SWSRC}, {short-label=ssc::inc::Irq.h, category=SWHDR}]
    generated-artifacts:
      dependency on artifact Irq_Cfg_h: artifact-descriptor={short-label=generate::template::inc::Irq_Cfg.h, category=SWTEMPLATE}, usages=COMPILE
      dependency on artifact Irq_xdm: artifact-descriptor={short-label=config::Irq.xdm, category=SWTOOL}, usages=CODEGENERATION
      dependency on artifact Irq_bmd: artifact-descriptor={short-label=autosar::TC36x::TC366x::irq.bmd, category=SWTOOL}, usages=CODEGENERATION
    resource consumption ResourceConsumption
      memory section CODE_QM_GLOBAL: alignment=UNSPECIFIED, sw-addrmethod=CODE
      section name prefix IRQ
