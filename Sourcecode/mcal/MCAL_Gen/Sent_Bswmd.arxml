AUTOSAR XML (schema 4-2-2)
# Copyright (C) Infineon Technologies (2021)
# All rights reserved.
package /AURIX2G_Sent/BswModuleDescriptions
  bsw module description Sent: category=BSW_MODULE, module-id=255  # Single Edge Nibble Transmission Driver
    provided-entrys:
      Sent_Init
      Sent_SetChannel
      Sent_ReadData
      Sent_ReadSerialData
      Sent_ReadChannelStatus
      Sent_SetWdgTimer
      Sent_ReadGlitchFilterStatus
      Sent_ResetGlitchFilterStatus
      Sent_FDFLParameters
      Sent_DeInit
      Sent_Isr
    bsw module dependency McalLibDependency: target-module-id=255, required-entrys=[Mcal_WritePeripEndInitProtReg, Mcal_GetCpuIndex]
    bsw internal behavior SentBehavior
      10 x bsw called entity, all with reentrancy-level=NON-REENTRANT:
        Sent_Init: implemented-entry=Sent_Init
        Sent_SetChannel: implemented-entry=Sent_SetChannel
        Sent_ReadData: implemented-entry=Sent_ReadData
        Sent_ReadSerialData: implemented-entry=Sent_ReadSerialData
        Sent_ReadChannelStatus: implemented-entry=Sent_ReadChannelStatus
        Sent_SetWdgTimer: implemented-entry=Sent_SetWdgTimer
        Sent_ReadGlitchFilterStatus: implemented-entry=Sent_ReadGlitchFilterStatus
        Sent_ResetGlitchFilterStatus: implemented-entry=Sent_ResetGlitchFilterStatus
        Sent_FDFLParameters: implemented-entry=Sent_FDFLParameters
        Sent_DeInit: implemented-entry=Sent_DeInit
      bsw interrupt entity Sent_Isr: reentrancy-level=MULTICORE-REENTRANT, implemented-entry=Sent_Isr, interrupt-category=CAT-1, interrupt-source=SRC_SENTm
package /AURIX2G_Sent/BswModuleEntrys
  11 x bsw module entry, all with is-synchronous=true, sw-service-impl-policy=STANDARD:
    Sent_Init: service-id=152, is-reentrant=false, call-type=REGULAR, execution-context=TASK
      sw service arg ConfigPtr: category=DATA_REFERENCE, sw-pointer-target-props={target-category=TYPE_REFERENCE, implementation-data-type=Sent_ConfigType}
    Sent_SetChannel: service-id=153, is-reentrant=false, call-type=REGULAR, execution-context=TASK
      sw service arg ChannelId: implementation-data-type=Sent_ChannelIdxType
      sw service arg Operation: implementation-data-type=Sent_ChanOpType
    Sent_ReadData: service-id=154, is-reentrant=false, call-type=REGULAR, execution-context=TASK
      return type Return: implementation-data-type=uint32
      sw service arg ChannelId: implementation-data-type=Sent_ChannelIdxType
    Sent_ReadSerialData: service-id=155, is-reentrant=false, call-type=REGULAR, execution-context=TASK
      sw service arg ChannelId: implementation-data-type=Sent_ChannelIdxType
      sw service arg DataPtr: category=DATA_REFERENCE, sw-pointer-target-props={target-category=TYPE_REFERENCE, implementation-data-type=Sent_RxSerialDataType}
    Sent_ReadChannelStatus: service-id=156, is-reentrant=false, call-type=REGULAR, execution-context=TASK
      sw service arg ChannelId: implementation-data-type=Sent_ChannelIdxType
      sw service arg StatPtr: category=DATA_REFERENCE, sw-pointer-target-props={target-category=TYPE_REFERENCE, implementation-data-type=Sent_ChanStatusType}
    Sent_SetWdgTimer: service-id=158, is-reentrant=false, call-type=REGULAR, execution-context=TASK
      sw service arg ChannelId: implementation-data-type=Sent_ChannelIdxType
      sw service arg WdgTimerReloadVal: implementation-data-type=uint16
    Sent_DeInit: service-id=160, is-reentrant=false, call-type=REGULAR, execution-context=TASK
    Sent_ReadGlitchFilterStatus: service-id=161, is-reentrant=false, call-type=REGULAR, execution-context=TASK
      return type Return: implementation-data-type=Std_ReturnType
      sw service arg ChannelId: implementation-data-type=Sent_ChannelIdxType
    Sent_ResetGlitchFilterStatus: service-id=162, is-reentrant=false, call-type=REGULAR, execution-context=TASK
      sw service arg ChannelId: implementation-data-type=Sent_ChannelIdxType
    Sent_FDFLParameters: service-id=163, is-reentrant=false, call-type=REGULAR, execution-context=TASK
      return type Return: implementation-data-type=Std_ReturnType
      sw service arg ChannelId: implementation-data-type=Sent_ChannelIdxType
    Sent_Isr: service-id=0, is-reentrant=true, call-type=INTERRUPT, execution-context=INTERRUPT-CAT-1
      sw service arg ChannelId: implementation-data-type=Sent_ChannelIdxType
package /AURIX2G_Sent/Implementations
  bsw implementation Sent: programming-language=C, sw-version=20.10.0, vendor-id=17, ar-release-version=4.2.2, behavior=SentBehavior, vendor-specific-module-def=Sent
    code-descriptors:
      code Files
        artifact-descriptors:
          short-label=ssc::src::Sent.c, category=SWSRC
          short-label=ssc::inc::Sent.h, category=SWHDR
          short-label=ssc::inc::Sent_Types.h, category=SWHDR
    generated-artifacts:
      5 x dependency on artifact:
        Sent_Cfg_h: artifact-descriptor={short-label=generate::inc:Sent_Cfg.h, category=SWTEMPLATE}, usages=COMPILE
        Sent_PBCfg_c: artifact-descriptor={short-label=generate::src::Sent_PBcfg.c, category=SWTEMPLATE}, usages=EXECUTE
        Sent_PBCfg_h: artifact-descriptor={short-label=generate::inc::Sent_PBcfg.h, category=SWTEMPLATE}, usages=EXECUTE
        Sent_xdm: artifact-descriptor={short-label=config::Sent.xdm, category=SWTOOL}, usages=CODEGENERATION
        Sent_bmd: artifact-descriptor={short-label=autosar::TC36x::TC366x::Sent.bmd, category=SWTOOL}, usages=CODEGENERATION
    resource consumption ResourceConsumption
      4 x memory section:
        VAR_CLEARED_QM_GLOBAL_8: alignment=8, sw-addrmethod=VAR_CLEARED
        VAR_CLEARED_QM_GLOBAL_32: alignment=32, sw-addrmethod=VAR_CLEARED
        CONFIG_DATA_QM_GLOBAL_UNSPECIFIED: alignment=UNSPECIFIED, sw-addrmethod=CONFIG_DATA
        CODE_QM_GLOBAL: alignment=UNSPECIFIED, sw-addrmethod=CODE
      section name prefix SENT
package /AURIX2G_Sent/ImplementationDataTypes
  14 x impl type, all with type-emitter=BSW:
    Sent_ChannelCfgType: category=STRUCTURE
      9 x element, all with category=TYPE_REFERENCE:
        ChanRxCtrl: implementation-data-type=uint32
        ChanIOCtrl: implementation-data-type=uint32
        ChanDataView: implementation-data-type=uint32
        ChanPreDiv: implementation-data-type=uint16
        ChanFracDiv: implementation-data-type=uint16
        ChanFrameLen: implementation-data-type=uint8
        ChanId: implementation-data-type=Sent_ChannelIdxType
        CallbackFn: implementation-data-type=Sent_NotifFnPtrType
        Sent_InterruptNode: implementation-data-type=uint8
    Sent_CoreConfigType: category=STRUCTURE
      element MaxChannels: implementation-data-type=Sent_ChannelIdxType
      element Sent_ChannelConfig: category=DATA_REFERENCE, sw-pointer-target-props={target-category=TYPE_REFERENCE, implementation-data-type=Sent_ChannelCfgType}
    Sent_ChannelMapType: category=STRUCTURE
      element Sent_ChannelCore: implementation-data-type=uint8
      element Sent_ChannelIndex: implementation-data-type=Sent_ChannelIdxType
    Sent_SpcMode: compu {0=SYNC_MODE, 1=BIDIRECTIONAL_MODE, 2=RANGE_SELECTION, 3=ID_SELECTION}, implementation-data-type=sint32, additional-native-type-qualifier=enum
    Sent_SpcTrigSrcType: compu {0=PULSE_STOP, 1=PULSE_START_IMMED, 2=PULSE_START_SYNC, 3=PULSE_START_EXT_TRIGGER}, implementation-data-type=sint32, additional-native-type-qualifier=enum
    Sent_SpcTimeBaseType: compu {0=PULSE_NOMINAL_FREQ, 1=PULSE_LAST_SYNC_FREQ}, implementation-data-type=sint32, additional-native-type-qualifier=enum
    Sent_ChanStateType: compu {0=STOP, 1=INITIALIZED, 2=RUNNING, 3=SYNCHRONIZED}, implementation-data-type=sint32, additional-native-type-qualifier=enum
    Sent_ChanOpType: compu {0=SENT_DISABLE, 1=SENT_ENABLE}, implementation-data-type=sint32, additional-native-type-qualifier=enum
    Sent_NotifFnPtrType: category=FUNCTION_REFERENCE, sw-pointer-target-props=Sent_Notification
    Sent_ChannelIdxType: implementation-data-type=uint8
    Sent_ConfigType: category=STRUCTURE
      7 x element:
        SentCorePtr: category=DATA_REFERENCE, array-size=2, array-size-semantics=FIXED-SIZE, sw-pointer-target-props={target-category=TYPE_REFERENCE, implementation-data-type=Sent_CoreConfigType}
        ModuleClkDiv: implementation-data-type=uint32
        ModuleFracDivStep: implementation-data-type=uint16
        NumChannelsConfigured: implementation-data-type=uint8
        Sent_ChannelLookUpTable: category=DATA_REFERENCE, sw-pointer-target-props={target-category=TYPE_REFERENCE, implementation-data-type=Sent_ChannelMapType}
        Sent_LogicalChanId: category=DATA_REFERENCE, sw-pointer-target-props={target-category=TYPE_REFERENCE, implementation-data-type=Sent_ChannelIdxType}
        Sent_PhysicalChanId: category=DATA_REFERENCE, sw-pointer-target-props={target-category=TYPE_REFERENCE, implementation-data-type=Sent_ChannelIdxType}
    Sent_SpcType: category=STRUCTURE
      5 x element, all with category=TYPE_REFERENCE:
        Mode: implementation-data-type=Sent_SpcMode
        TriggerSource: implementation-data-type=Sent_SpcTrigSrcType
        TimeBase: implementation-data-type=Sent_SpcTimeBaseType
        PulseLength: implementation-data-type=uint8
        Delay: implementation-data-type=uint8
    Sent_RxSerialDataType: category=STRUCTURE
      4 x element, all with category=TYPE_REFERENCE:
        Data: implementation-data-type=uint16
        MsgId: implementation-data-type=uint8
        Crc: implementation-data-type=uint8
        Configuration: implementation-data-type=uint8
    Sent_ChanStatusType: category=STRUCTURE
      5 x element, all with category=TYPE_REFERENCE:
        ChanStat: implementation-data-type=Sent_ChanStateType
        RxTimeStamp: implementation-data-type=uint32
        IntStat: implementation-data-type=uint32
        RxCrc: implementation-data-type=uint8
        StatCommNibble: implementation-data-type=uint8
