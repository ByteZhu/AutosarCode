AUTOSAR XML (schema 4-2-2)
package /AUTOSAR_Rte/BswImplementations
  bsw implementation Rte: mc-support=mc-sw-emulation-method-support=category=NONE
package /AUTOSAR_Rte/Units
  56 x unit:
    DBC_SysDesc_Can_Network_0_Pkg_Units_rpm
    DBC_SysDesc_Can_Network_0_Pkg_Units_Ampere
    DBC_SysDesc_Can_Network_0_Pkg_Units_deg
    DBC_SysDesc_Can_Network_0_Pkg_Units_Nm
    DBC_SysDesc_Can_Network_0_Pkg_Units_V
    DBC_SysDesc_Can_Network_0_Pkg_Units_Unitless
    DBC_SysDesc_Can_Network_0_Pkg_Units_NewtonMeter
    DBC_SysDesc_Can_Network_0_Pkg_Units_KiloMtr
    DBC_SysDesc_Can_Network_0_Pkg_Units_Volt
    DBC_SysDesc_Can_Network_0_Pkg_Units_m_s_2
    DBC_SysDesc_Can_Network_0_Pkg_Units_m_s_cubed
    DBC_SysDesc_Can_Network_0_Pkg_Units_rad_s
    DBC_SysDesc_Can_Network_0_Pkg_Units_rad
    DBC_SysDesc_Can_Network_0_Pkg_Units_degC
    DBC_SysDesc_Can_Network_0_Pkg_Units_m_s
    DBC_SysDesc_Can_Network_0_Pkg_Units_N
    AUTOSAR_CanIf_Units_NoUnit: display-name=noUnit, factor-si-to-unit=1.0, offset-si-to-unit=0.0, physical-dimension=AUTOSAR_CanIf_PhysicalDimensions_NoUnit  # No Unit
    AUTOSAR_CanNm_Units_NoUnit: display-name=noUnit, factor-si-to-unit=1.0, offset-si-to-unit=0.0, physical-dimension=AUTOSAR_CanNm_PhysicalDimensions_NoUnit  # No Unit
    AUTOSAR_CanSM_Units_NoUnit: display-name=noUnit, factor-si-to-unit=1.0, offset-si-to-unit=0.0, physical-dimension=AUTOSAR_CanSM_PhysicalDimensions_NoUnit  # No Unit
    AUTOSAR_ComM_Units_NoUnit: display-name=noUnit, factor-si-to-unit=1.0, offset-si-to-unit=0.0, physical-dimension=AUTOSAR_ComM_PhysicalDimensions_NoUnit  # No Unit
    AUTOSAR_Com_Units_NoUnit: display-name=noUnit, factor-si-to-unit=1.0, offset-si-to-unit=0.0, physical-dimension=AUTOSAR_Com_PhysicalDimensions_NoUnit  # No Unit
    AUTOSAR_Nm_Units_NoUnit: display-name=noUnit, factor-si-to-unit=1.0, offset-si-to-unit=0.0, physical-dimension=AUTOSAR_Nm_PhysicalDimensions_NoUnit  # No Unit
    AUTOSAR_NvM_Units_NoUnit: display-name=noUnit, factor-si-to-unit=1.0, offset-si-to-unit=0.0, physical-dimension=AUTOSAR_NvM_PhysicalDimensions_NoUnit  # No Unit
    AUTOSAR_PduR_Units_NoUnit: display-name=noUnit, factor-si-to-unit=1.0, offset-si-to-unit=0.0, physical-dimension=AUTOSAR_PduR_PhysicalDimensions_NoUnit  # No Unit
    AUTOSAR_Xcp_Units_NoUnit: display-name=noUnit, factor-si-to-unit=1.0, offset-si-to-unit=0.0, physical-dimension=AUTOSAR_Xcp_PhysicalDimensions_NoUnit  # No Unit
    RB_RBA_rba_MemLib_Units_Mem_NoUnit: display-name=Mem_NoUnit, factor-si-to-unit=1.0, offset-si-to-unit=0.0, physical-dimension=RB_RBA_rba_MemLib_PhysicalDimensions_Mem_NoPhysDim  # Mem No Unit / 1:1 / Identical
    AUTOSAR_AISpecification_Units_Bar: display-name=bar, factor-si-to-unit=1.0E-5, physical-dimension=AUTOSAR_AISpecification_PhysicalDimensions_LenNeg1M1TiNeg2  # Bar | pressure, no SI unit; 1 bar = 100,000 Pascal (Pa)
    AUTOSAR_AISpecification_Units_DegCgrd: display-name=degC, factor-si-to-unit=1.0, offset-si-to-unit=-273.15, physical-dimension=AUTOSAR_AISpecification_PhysicalDimensions_T1  # Degree Centigrade | temperature, no SI unit, (degC = K - 273.15)
    AUTOSAR_AISpecification_Units_HectoPa: display-name=hPa, factor-si-to-unit=0.01, physical-dimension=AUTOSAR_AISpecification_PhysicalDimensions_LenNeg1M1TiNeg2  # Hecto Pascal | SI derived unit of pressure with prefix | It is equivalent to one Newton per square meter. In everyday life, the Pascal is perhaps best known from meteorological air-pressure reports, where it occurs in the form of hecto Pascal (1 hPa = 100 Pa).
    AUTOSAR_AISpecification_Units_Hz: display-name=Hz, factor-si-to-unit=1.0, physical-dimension=AUTOSAR_AISpecification_PhysicalDimensions_TiNeg1  # Hertz | SI derived unit of frequency
    AUTOSAR_AISpecification_Units_Kelvin: display-name=K, factor-si-to-unit=1.0, physical-dimension=AUTOSAR_AISpecification_PhysicalDimensions_T1  # Kelvin | SI base unit of thermodynamic temperature
    AUTOSAR_AISpecification_Units_KiloGr: display-name=kg, factor-si-to-unit=1.0, physical-dimension=AUTOSAR_AISpecification_PhysicalDimensions_M1  # Kilo Gram | SI base unit of mass
    AUTOSAR_AISpecification_Units_KiloHz: display-name=kHz, factor-si-to-unit=0.001, physical-dimension=AUTOSAR_AISpecification_PhysicalDimensions_TiNeg1  # Kilo Hertz | SI derived unit of frequency with prefix
    AUTOSAR_AISpecification_Units_KiloMtr: display-name=km, factor-si-to-unit=0.001, physical-dimension=AUTOSAR_AISpecification_PhysicalDimensions_Len1  # Kilo Meter | SI base unit of length with prefix
    AUTOSAR_AISpecification_Units_Mtr: display-name=m, factor-si-to-unit=1.0, physical-dimension=AUTOSAR_AISpecification_PhysicalDimensions_Len1  # Meter | SI base unit of length
    AUTOSAR_AISpecification_Units_MtrPerSec: display-name=m/s, factor-si-to-unit=1.0, physical-dimension=AUTOSAR_AISpecification_PhysicalDimensions_Len1TiNeg1  # Meter per Second | SI derived unit of velocity
    AUTOSAR_AISpecification_Units_MtrPerSecCubd: display-name=m/s^3, factor-si-to-unit=1.0, physical-dimension=AUTOSAR_AISpecification_PhysicalDimensions_Len1TiNeg3  # Meter per Second Cubed | jerk (derived from SI units), also called jolt (esp. in British English), surge or lurch, is the rate of change of acceleration; more precisely, the derivative of acceleration with respect to time, the second derivative of velocity, or the third derivative of displacement.
    AUTOSAR_AISpecification_Units_MtrPerSecSqd: display-name=m/s^2, factor-si-to-unit=1.0, physical-dimension=AUTOSAR_AISpecification_PhysicalDimensions_Len1TiNeg2  # Meter per Second Squared | SI derived unit of acceleration
    AUTOSAR_AISpecification_Units_MtrRecpr: display-name=1/m, factor-si-to-unit=1.0, physical-dimension=AUTOSAR_AISpecification_PhysicalDimensions_LenNeg1  # Meter Reciprocal | SI derived unit of wave number for electromagnetic fields or curvature as reciprocal of curve radius
    AUTOSAR_AISpecification_Units_NoUnit: display-name=-, factor-si-to-unit=1.0, physical-dimension=AUTOSAR_AISpecification_PhysicalDimensions_NoDimension  # No Unit | Unit for dimensionless continuous value data types like numbers, factors and coefficients
    AUTOSAR_AISpecification_Units_Nwt: display-name=N, factor-si-to-unit=1.0, physical-dimension=AUTOSAR_AISpecification_PhysicalDimensions_Len1M1TiNeg2  # Newton | SI derived unit of force
    AUTOSAR_AISpecification_Units_NwtMtr: display-name=Nm, factor-si-to-unit=1.0, physical-dimension=AUTOSAR_AISpecification_PhysicalDimensions_Len2M1TiNeg2  # Newton Meter | SI derived unit of moment of force (torque = kg m^2/s^2)
    AUTOSAR_AISpecification_Units_NwtMtrPerSec: display-name=Nm/s, factor-si-to-unit=1.0, physical-dimension=AUTOSAR_AISpecification_PhysicalDimensions_Len2M1TiNeg3  # Newton Meter per Second | SI derived unit of time-derivative of torque
    AUTOSAR_AISpecification_Units_NwtPerMtr: display-name=N/m, factor-si-to-unit=1.0, physical-dimension=AUTOSAR_AISpecification_PhysicalDimensions_M1TiNeg2  # Newton per Meter | surface tension (derived from SI units)
    AUTOSAR_AISpecification_Units_NwtSecPerMtr: display-name=Ns/m, factor-si-to-unit=1.0, physical-dimension=AUTOSAR_AISpecification_PhysicalDimensions_M1TiNeg1  # Newton Second per Meter | damping factor or coefficient (derived from SI units)
    AUTOSAR_AISpecification_Units_Pa: display-name=Pa, factor-si-to-unit=1.0, physical-dimension=AUTOSAR_AISpecification_PhysicalDimensions_LenNeg1M1TiNeg2  # Pascal | SI derived unit of pressure | The Pascal (symbol: Pa) is the SI derived unit of pressure or stress (also: Young's modulus and tensile strength). It is equivalent to one Newton per square meter. In everyday life, the Pascal is perhaps best known from meteorological air-pressure reports.
    AUTOSAR_AISpecification_Units_Perc: display-name=%, factor-si-to-unit=100.0, physical-dimension=AUTOSAR_AISpecification_PhysicalDimensions_NoDimension  # Percent | a percentage is a way of expressing a number as a fraction of 100 (no SI unit).
    AUTOSAR_AISpecification_Units_PercPerSec: display-name=%/s, factor-si-to-unit=100.0, physical-dimension=AUTOSAR_AISpecification_PhysicalDimensions_TiNeg1  # Percent per Second | time-derivative of percent
    AUTOSAR_AISpecification_Units_Rad: display-name=rad, factor-si-to-unit=1.0, physical-dimension=AUTOSAR_AISpecification_PhysicalDimensions_NoDimension  # Radian | SI derived unit of plane angle (dimensionless)
    AUTOSAR_AISpecification_Units_RadPerSec: display-name=rad/s, factor-si-to-unit=1.0, physical-dimension=AUTOSAR_AISpecification_PhysicalDimensions_TiNeg1  # Radian per Second | SI derived unit of angular velocity
    AUTOSAR_AISpecification_Units_RadPerSecSqd: display-name=rad/s^2, factor-si-to-unit=1.0, physical-dimension=AUTOSAR_AISpecification_PhysicalDimensions_TiNeg2  # Radian per Second Squared | SI derived unit of angular acceleration
    AUTOSAR_AISpecification_Units_Rpm: display-name=rpm, factor-si-to-unit=0.0166666666666667, physical-dimension=AUTOSAR_AISpecification_PhysicalDimensions_TiNeg1  # Rpm | revolutions per minute - no SI unit
    AUTOSAR_AISpecification_Units_RpmPerSec: display-name=rpm/s, factor-si-to-unit=0.0166666666666667, physical-dimension=AUTOSAR_AISpecification_PhysicalDimensions_TiNeg2  # Revolutions per minute per Second | time-derivative of revolutions per minute - no SI unit
    AUTOSAR_AISpecification_Units_Sec: display-name=s, factor-si-to-unit=1.0, physical-dimension=AUTOSAR_AISpecification_PhysicalDimensions_Ti1  # Second | SI base unit of time
    AUTOSAR_AISpecification_Units_Volt: display-name=V, factor-si-to-unit=1.0, physical-dimension=AUTOSAR_AISpecification_PhysicalDimensions_Len2M1TiNeg3INeg1  # Volt | SI derived unit of electric potential difference
    RB_RBA_Common_CentralElements_Units_NoUnit: display-name=noUnit, factor-si-to-unit=1.0, offset-si-to-unit=0.0, physical-dimension=RB_RBA_Common_CentralElements_PhysicalDimensions_NoUnit  # No Unit
package /AUTOSAR_Rte/PhysicalDimensions
  29 x physical dimension:
    AUTOSAR_CanIf_PhysicalDimensions_NoUnit: length-exp=0
    AUTOSAR_CanNm_PhysicalDimensions_NoUnit: length-exp=0
    AUTOSAR_CanSM_PhysicalDimensions_NoUnit: length-exp=0
    AUTOSAR_ComM_PhysicalDimensions_NoUnit: length-exp=0
    AUTOSAR_Com_PhysicalDimensions_NoUnit: length-exp=0
    AUTOSAR_Nm_PhysicalDimensions_NoUnit: length-exp=0
    AUTOSAR_NvM_PhysicalDimensions_NoUnit: length-exp=0
    AUTOSAR_PduR_PhysicalDimensions_NoUnit: length-exp=0
    AUTOSAR_Xcp_PhysicalDimensions_NoUnit: length-exp=0
    RB_RBA_rba_MemLib_PhysicalDimensions_Mem_NoPhysDim: length-exp=0
    AUTOSAR_AISpecification_PhysicalDimensions_LenNeg1M1TiNeg2: length-exp=-1, mass-exp=1, time-exp=-2  # Length -1 Mass 1 Time -2
    AUTOSAR_AISpecification_PhysicalDimensions_T1: temperature-exp=1  # Temperature 1
    AUTOSAR_AISpecification_PhysicalDimensions_TiNeg1: time-exp=-1  # Time -1
    AUTOSAR_AISpecification_PhysicalDimensions_M1: mass-exp=1  # Mass 1
    AUTOSAR_AISpecification_PhysicalDimensions_Len1: length-exp=1  # Length 1
    AUTOSAR_AISpecification_PhysicalDimensions_Len1TiNeg1: length-exp=1, time-exp=-1  # Length 1 Time -1
    AUTOSAR_AISpecification_PhysicalDimensions_Len1TiNeg3: length-exp=1, time-exp=-3  # Length 1 Time -3
    AUTOSAR_AISpecification_PhysicalDimensions_Len1TiNeg2: length-exp=1, time-exp=-2  # Length 1 Time -2
    AUTOSAR_AISpecification_PhysicalDimensions_LenNeg1: length-exp=-1  # Length -1
    AUTOSAR_AISpecification_PhysicalDimensions_NoDimension  # No Dimension
    AUTOSAR_AISpecification_PhysicalDimensions_Len1M1TiNeg2: length-exp=1, mass-exp=1, time-exp=-2  # Length 1 Mass 1 Time -2
    AUTOSAR_AISpecification_PhysicalDimensions_Len2M1TiNeg2: length-exp=2, mass-exp=1, time-exp=-2  # Length 2 Mass 1 Time -2
    AUTOSAR_AISpecification_PhysicalDimensions_Len2M1TiNeg3: length-exp=2, mass-exp=1, time-exp=-3  # Length 2 Mass 1 Time -3
    AUTOSAR_AISpecification_PhysicalDimensions_M1TiNeg2: mass-exp=1, time-exp=-2  # Mass 1 Time -2
    AUTOSAR_AISpecification_PhysicalDimensions_M1TiNeg1: mass-exp=1, time-exp=-1  # Mass 1 Time -1
    AUTOSAR_AISpecification_PhysicalDimensions_TiNeg2: time-exp=-2  # Time -2
    AUTOSAR_AISpecification_PhysicalDimensions_Ti1: time-exp=1  # Time 1
    AUTOSAR_AISpecification_PhysicalDimensions_Len2M1TiNeg3INeg1: length-exp=2, mass-exp=1, time-exp=-3, current-exp=-1  # Length 2 Mass 1 Time -3 Electric current -1
    RB_RBA_Common_CentralElements_PhysicalDimensions_NoUnit: length-exp=0
